## build_dongle/uwb-tag-firmware/Kconfig/boards/Kconfig
```kconfig
# Load Zephyr board Kconfig descriptions.
osource "C:/ncs/v2.7.0/nrf/boards/nordic/nrf52833dongle/Kconfig"
```

## build_dongle/uwb-tag-firmware/Kconfig/boards/Kconfig.defconfig
```kconfig
# Load Zephyr board defconfig descriptions.
osource "C:/ncs/v2.7.0/nrf/boards/nordic/nrf52833dongle/Kconfig.defconfig"
```

## build_dongle/uwb-tag-firmware/Kconfig/boards/Kconfig.nrf52833dongle
```kconfig
# Load board Kconfig descriptions.
osource "C:/ncs/v2.7.0/nrf/boards/nordic/nrf52833dongle/Kconfig.nrf52833dongle"
```
